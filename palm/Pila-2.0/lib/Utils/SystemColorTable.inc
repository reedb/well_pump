; System Color Table

RGB_FFFFFF	equ	$00
RGB_FFCCFF	equ	$01
RGB_FF99FF	equ	$02
RGB_FF66FF	equ	$03
RGB_FF33FF	equ	$04
RGB_FF00FF	equ	$05
RGB_FFFFCC	equ	$06
RGB_FFCCCC	equ	$07
RGB_FF99CC	equ	$08
RGB_FF66CC	equ	$09
RGB_FF33CC	equ	$0A
RGB_FF00CC	equ	$0B
RGB_FFFF99	equ	$0C
RGB_FFCC99	equ	$0D
RGB_FF9999	equ	$0E
RGB_FF6699	equ	$0F
RGB_FF3399	equ	$10
RGB_FF0099	equ	$11
RGB_CCFFFF	equ	$12
RGB_CCCCFF	equ	$13
RGB_CC99FF	equ	$14
RGB_CC66FF	equ	$15
RGB_CC33FF	equ	$16
RGB_CC00FF	equ	$17
RGB_CCFFCC	equ	$18
RGB_CCCCCC	equ	$19
RGB_CC99CC	equ	$1A
RGB_CC66CC	equ	$1B
RGB_CC33CC	equ	$1C
RGB_CC00CC	equ	$1D
RGB_CCFF99	equ	$1E
RGB_CCCC99	equ	$1F
RGB_CC9999	equ	$20
RGB_CC6699	equ	$21
RGB_CC3399	equ	$22
RGB_CC0099	equ	$23
RGB_99FFFF	equ	$24
RGB_99CCFF	equ	$25
RGB_9999FF	equ	$26
RGB_9966FF	equ	$27
RGB_9933FF	equ	$28
RGB_9900FF	equ	$29
RGB_99FFCC	equ	$2A
RGB_99CCCC	equ	$2B
RGB_9999CC	equ	$2C
RGB_9966CC	equ	$2D
RGB_9933CC	equ	$2E
RGB_9900CC	equ	$2F
RGB_99FF99	equ	$30
RGB_99CC99	equ	$31
RGB_999999	equ	$32
RGB_996699	equ	$33
RGB_993399	equ	$34
RGB_990099	equ	$35
RGB_66FFFF	equ	$36
RGB_66CCFF	equ	$37
RGB_6699FF	equ	$38
RGB_6666FF	equ	$39
RGB_6633FF	equ	$3A
RGB_6600FF	equ	$3B
RGB_66FFCC	equ	$3C
RGB_66CCCC	equ	$3D
RGB_6699CC	equ	$3E
RGB_6666CC	equ	$3F
RGB_6633CC	equ	$40
RGB_6600CC	equ	$41
RGB_66FF99	equ	$42
RGB_66CC99	equ	$43
RGB_669999	equ	$44
RGB_666699	equ	$45
RGB_663399	equ	$46
RGB_660099	equ	$47
RGB_33FFFF	equ	$48
RGB_33CCFF	equ	$49
RGB_3399FF	equ	$4A
RGB_3366FF	equ	$4B
RGB_3333FF	equ	$4C
RGB_3300FF	equ	$4D
RGB_33FFCC	equ	$4E
RGB_33CCCC	equ	$4F
RGB_3399CC	equ	$50
RGB_3366CC	equ	$51
RGB_3333CC	equ	$52
RGB_3300CC	equ	$53
RGB_33FF99	equ	$54
RGB_33CC99	equ	$55
RGB_339999	equ	$56
RGB_336699	equ	$57
RGB_333399	equ	$58
RGB_330099	equ	$59
RGB_00FFFF	equ	$5A
RGB_00CCFF	equ	$5B
RGB_0099FF	equ	$5C
RGB_0066FF	equ	$5D
RGB_0033FF	equ	$5E
RGB_0000FF	equ	$5F
RGB_00FFCC	equ	$60
RGB_00CCCC	equ	$61
RGB_0099CC	equ	$62
RGB_0066CC	equ	$63
RGB_0033CC	equ	$64
RGB_0000CC	equ	$65
RGB_00FF99	equ	$66
RGB_00CC99	equ	$67
RGB_009999	equ	$68
RGB_006699	equ	$69
RGB_003399	equ	$6A
RGB_000099	equ	$6B
RGB_FFFF66	equ	$6C
RGB_FFCC66	equ	$6D
RGB_FF9966	equ	$6E
RGB_FF6666	equ	$6F
RGB_FF3366	equ	$70
RGB_FF0066	equ	$71
RGB_FFFF33	equ	$72
RGB_FFCC33	equ	$73
RGB_FF9933	equ	$74
RGB_FF6633	equ	$75
RGB_FF3333	equ	$76
RGB_FF0033	equ	$77
RGB_FFFF00	equ	$78
RGB_FFCC00	equ	$79
RGB_FF9900	equ	$7A
RGB_FF6600	equ	$7B
RGB_FF3300	equ	$7C
RGB_FF0000	equ	$7D
RGB_CCFF66	equ	$7E
RGB_CCCC66	equ	$7F
RGB_CC9966	equ	$80
RGB_CC6666	equ	$81
RGB_CC3366	equ	$82
RGB_CC0066	equ	$83
RGB_CCFF33	equ	$84
RGB_CCCC33	equ	$85
RGB_CC9933	equ	$86
RGB_CC6633	equ	$87
RGB_CC3333	equ	$88
RGB_CC0033	equ	$89
RGB_CCFF00	equ	$8A
RGB_CCCC00	equ	$8B
RGB_CC9900	equ	$8C
RGB_CC6600	equ	$8D
RGB_CC3300	equ	$8E
RGB_CC0000	equ	$8F
RGB_99FF66	equ	$90
RGB_99CC66	equ	$91
RGB_999966	equ	$92
RGB_996666	equ	$93
RGB_993366	equ	$94
RGB_990066	equ	$95
RGB_99FF33	equ	$96
RGB_99CC33	equ	$97
RGB_999933	equ	$98
RGB_996633	equ	$99
RGB_993333	equ	$9A
RGB_990033	equ	$9B
RGB_99FF00	equ	$9C
RGB_99CC00	equ	$9D
RGB_999900	equ	$9E
RGB_996600	equ	$9F
RGB_993300	equ	$A0
RGB_990000	equ	$A1
RGB_66FF66	equ	$A2
RGB_66CC66	equ	$A3
RGB_669966	equ	$A4
RGB_666666	equ	$A5
RGB_663366	equ	$A6
RGB_660066	equ	$A7
RGB_66FF33	equ	$A8
RGB_66CC33	equ	$A9
RGB_669933	equ	$AA
RGB_666633	equ	$AB
RGB_663333	equ	$AC
RGB_660033	equ	$AD
RGB_66FF00	equ	$AE
RGB_66CC00	equ	$AF
RGB_669900	equ	$B0
RGB_666600	equ	$B1
RGB_663300	equ	$B2
RGB_660000	equ	$B3
RGB_33FF66	equ	$B4
RGB_33CC66	equ	$B5
RGB_339966	equ	$B6
RGB_336666	equ	$B7
RGB_333366	equ	$B8
RGB_330066	equ	$B9
RGB_33FF33	equ	$BA
RGB_33CC33	equ	$BB
RGB_339933	equ	$BC
RGB_336633	equ	$BD
RGB_333333	equ	$BE
RGB_330033	equ	$BF
RGB_33FF00	equ	$C0
RGB_33CC00	equ	$C1
RGB_339900	equ	$C2
RGB_336600	equ	$C3
RGB_333300	equ	$C4
RGB_330000	equ	$C5
RGB_00FF66	equ	$C6
RGB_00CC66	equ	$C7
RGB_009966	equ	$C8
RGB_006666	equ	$C9
RGB_003366	equ	$CA
RGB_000066	equ	$CB
RGB_00FF33	equ	$CC
RGB_00CC33	equ	$CD
RGB_009933	equ	$CE
RGB_006633	equ	$CF
RGB_003333	equ	$D0
RGB_000033	equ	$D1
RGB_00FF00	equ	$D2
RGB_00CC00	equ	$D3
RGB_009900	equ	$D4
RGB_006600	equ	$D5
RGB_003300	equ	$D6
RGB_111111	equ	$D7
RGB_222222	equ	$D8
RGB_444444	equ	$D9
RGB_555555	equ	$DA
RGB_777777	equ	$DB
RGB_888888	equ	$DC
RGB_AAAAAA	equ	$DD
RGB_BBBBBB	equ	$DE
RGB_DDDDDD	equ	$DF
RGB_EEEEEE	equ	$E0
RGB_C0C0C0	equ	$E1
RGB_800000	equ	$E2
RGB_800080	equ	$E3
RGB_008000	equ	$E4
RGB_008080	equ	$E5
RGB_000000	equ	$E6
